## sdkconfig.defaults
```kconfig
# Waveshare ESP32-S3-Touch-AMOLED-1.75 baseline
CONFIG_IDF_TARGET="esp32s3"
CONFIG_ESP_DEFAULT_CPU_FREQ_MHZ_240=y
CONFIG_ESPTOOLPY_FLASHSIZE_16MB=y

# Use the board's 8 MB octal PSRAM for LVGL assets and application state.
CONFIG_SPIRAM=y
CONFIG_SPIRAM_MODE_OCT=y
CONFIG_SPIRAM_SPEED_80M=y
CONFIG_SPIRAM_USE_MALLOC=y

# Keep DMA traffic in small strips instead of redrawing a 424 KiB full frame.
CONFIG_BSP_DISPLAY_LVGL_BUF_HEIGHT=40
CONFIG_COMPILER_OPTIMIZATION_PERF=y

# Fonts used by the first UI prototype.
CONFIG_LV_FONT_MONTSERRAT_14=y
CONFIG_LV_FONT_MONTSERRAT_18=y
CONFIG_LV_FONT_MONTSERRAT_24=y
CONFIG_LV_FONT_MONTSERRAT_32=y
CONFIG_LV_FONT_MONTSERRAT_48=y

# Useful during the performance-prototype phase.
CONFIG_LV_USE_PERF_MONITOR=y
CONFIG_LV_USE_MEM_MONITOR=y
```
